## config/west.yml
```yaml
manifest:
  defaults:
    revision: main
  remotes:
    - name: zmkfirmware
      url-base: https://github.com/zmkfirmware
    - name: urob
      url-base: https://github.com/urob
    - name: splitkb
      url-base: https://github.com/splitkb
  projects:
    - name: zmk
      remote: zmkfirmware
      import: app/west.yml
    - name: zmk-adaptive-key
      remote: urob
    - name: zmk-halcyon-module
      remote: splitkb
      revision: main
  self:
    path: config
```
