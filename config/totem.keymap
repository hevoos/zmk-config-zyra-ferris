// Totem (38 keys) - Sweep layout on the 38-key matrix
// All behaviors, combos, macros and layers live in common/keymap.dtsi.

// Sweep key number -> physical key position on this board
#define POS00 0
#define POS01 1
#define POS02 2
#define POS03 3
#define POS04 4
#define POS05 5
#define POS06 6
#define POS07 7
#define POS08 8
#define POS09 9
#define POS10 10
#define POS11 11
#define POS12 12
#define POS13 13
#define POS14 14
#define POS15 15
#define POS16 16
#define POS17 17
#define POS18 18
#define POS19 19
#define POS20 21
#define POS21 22
#define POS22 23
#define POS23 24
#define POS24 25
#define POS25 26
#define POS26 27
#define POS27 28
#define POS28 29
#define POS29 30
#define POS30 33
#define POS31 34
#define POS32 35
#define POS33 36

// Place the 34 Sweep keys into this board's layout
#define LAYOUT(k00,k01,k02,k03,k04,k05,k06,k07,k08,k09,k10,k11,k12,k13,k14,k15,k16,k17,k18,k19,k20,k21,k22,k23,k24,k25,k26,k27,k28,k29,k30,k31,k32,k33) \
  k00 k01 k02 k03 k04 k05 k06 k07 k08 k09 \
  k10 k11 k12 k13 k14 k15 k16 k17 k18 k19 \
  &sk RALT k20 k21 k22 k23 k24 k25 k26 k27 k28 k29 &sk RALT \
  &none k30 k31 k32 k33 &none

#include "common/keymap.dtsi"
